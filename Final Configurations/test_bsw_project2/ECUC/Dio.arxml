AUTOSAR XML (schema 4.0)
package /test_bsw_project2
  module config Dio
    ecuc param conf container DioConfig: destination=AUTOSAR/test_bsw_project2/Dio/DioConfig
      ecuc param conf container DioPort_0: destination=AUTOSAR/test_bsw_project2/Dio/DioConfig/DioPort/DioPort_0
        ecuc integer param value DioPortId: value=5
        6 x ecuc param conf container:
          DioChannel_0: destination=AUTOSAR/test_bsw_project2/Dio/DioConfig/DioPort/DioPort_0/DioChannel/DioChannel_0
            ecuc integer param value DioChannelId: value=0
          DioChannel_1: destination=AUTOSAR/test_bsw_project2/Dio/DioConfig/DioPort/DioPort_0/DioChannel/DioChannel_1
            ecuc integer param value DioChannelId: value=1
          DioChannel_2: destination=AUTOSAR/test_bsw_project2/Dio/DioConfig/DioPort/DioPort_0/DioChannel/DioChannel_2
            ecuc integer param value DioChannelId: value=2
          DioChannel_3: destination=AUTOSAR/test_bsw_project2/Dio/DioConfig/DioPort/DioPort_0/DioChannel/DioChannel_3
            ecuc integer param value DioChannelId: value=3
          DioChannel_4: destination=AUTOSAR/test_bsw_project2/Dio/DioConfig/DioPort/DioPort_0/DioChannel/DioChannel_4
            ecuc integer param value DioChannelId: value=4
          DioChannelGroup_0: destination=AUTOSAR/test_bsw_project2/Dio/DioConfig/DioPort/DioPort_0/DioChannelGroup/DioChannelGroup_0
            ecuc string param value DioChannelGroupIdentification: value=Led_Group
            ecuc integer param value DioPortMask: value=14
            ecuc integer param value DioPortOffset: value=1
    ecuc param conf container DioGeneral: destination=AUTOSAR/test_bsw_project2/Dio/DioGeneral
      ecuc boolean param value DioDevErrorDetect: value=0
      ecuc boolean param value DioFlipChannelApi: value=1
      ecuc boolean param value DioVersionInfoApi: value=0
