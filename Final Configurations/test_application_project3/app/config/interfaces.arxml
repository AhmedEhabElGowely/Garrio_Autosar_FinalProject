AUTOSAR XML (schema 00046)
package /Interfaces
  sender receiver interface SR_Led_Command
    data SR_Led_Command_Element_1: type=Led_Command
  client server interface CS_GetButtonReading
    operation CS_GetButtonReading_Operation_1
      arg CS_GetButtonReading_Operation_1_Argument_1: type=Button_Status, direction=OUT
    operation CS_GetButtonReading_Operation_2
      arg CS_GetButtonReading_Operation_2_Argument_1: type=Button_Status, direction=OUT
  client server interface CS_ControlLed
    operation CS_ControlLed_Operation_1
      arg CS_ControlLed_Operation_1_Argument_1: type=Led_Status, direction=IN
