AUTOSAR XML (schema 00046)
package /FlatMap_package
  flat map FlatMap
    flat instance descriptor ButtonManager_Composition_Prototype: upstream-reference=RootSwCompositionPrototype_0.ButtonManager_Composition_Prototype, ecu-extract-reference=EcuInstance_0_FlatView.ButtonManager_Composition_Prototype
    flat instance descriptor LedControl_Composition_Prototype: upstream-reference=RootSwCompositionPrototype_0.LedControl_Composition_Prototype, ecu-extract-reference=EcuInstance_0_FlatView.LedControl_Composition_Prototype
    flat instance descriptor CDD_Composition_Prototype: upstream-reference=RootSwCompositionPrototype_0.CDD_Composition_Prototype, ecu-extract-reference=EcuInstance_0_FlatView.CDD_Composition_Prototype
