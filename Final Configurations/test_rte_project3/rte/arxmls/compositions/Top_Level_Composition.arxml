AUTOSAR XML (schema 00046)
package /Top_Level_Composition_package
  composition sw component type Top_Level_Composition
    component ButtonManager_Composition_Prototype: type=ButtonManager_SWC_1
    component LedControl_Composition_Prototype: type=LedControl_SWC_2
    component CDD_Composition_Prototype: type=CDD_SWC_1
    connect CDD_Composition_Prototype.pp_ButtonReading -> ButtonManager_Composition_Prototype.rp_ButtonReading
    connect ButtonManager_Composition_Prototype.pp_Button_LedCommand -> LedControl_Composition_Prototype.rp_Button_LedCommand
    connect CDD_Composition_Prototype.pp_ControlLed -> LedControl_Composition_Prototype.rp_ControlLed
